## main/Kconfig.projbuild
```kconfig
menu "TIC Configuration"

    config TIC_INPUT_GPIO_A
        int "Channel A input GPIO"
        default 4
        range 0 48
        help
            GPIO pin for Channel A capture input.

    config TIC_INPUT_GPIO_B
        int "Channel B input GPIO"
        default 5
        range 0 48
        help
            GPIO pin for Channel B capture input.

    menu "Signal Generator"
        config TIC_SIGGEN_A_FREQ_HZ
            int "Generator A frequency (Hz), 0 to disable"
            default 1000
            range 0 1000000
            help
                Frequency for signal generator A. Set to 0 to disable.
                Loopback is auto-enabled if generator GPIO matches capture GPIO.

        config TIC_SIGGEN_A_GPIO
            int "Generator A GPIO"
            default 6
            range 0 48
            help
                GPIO pin for signal generator A output.
                Set equal to Channel A input GPIO for loopback mode.

        config TIC_SIGGEN_B_FREQ_HZ
            int "Generator B frequency (Hz), 0 to disable"
            default 1000
            range 0 1000000
            help
                Frequency for signal generator B. Set to 0 to disable.
                Loopback is auto-enabled if generator GPIO matches capture GPIO.

        config TIC_SIGGEN_B_GPIO
            int "Generator B GPIO"
            default 7
            range 0 48
            help
                GPIO pin for signal generator B output.
                Set equal to Channel B input GPIO for loopback mode.

        config TIC_SIGGEN_B_DELAY_NS
            int "Generator B relative delay (ns)"
            default 0
            range -1000000000 1000000000
            help
                Delay of generator B rising edge relative to A, in nanoseconds.
                Positive = B lags A, Negative = B leads A.
    endmenu

    config TIC_MAX_BUFFER_SIZE
        int "Maximum buffer size (events)"
        default 8192
        range 256 32768
        help
            Maximum number of events each buffer can hold.
            Two buffers are allocated (double buffering).
            Memory usage: 2 * MAX_BUFFER_SIZE * 8 bytes.

    config TIC_EDGES_PER_BUFFER
        int "Edges per buffer (swap threshold)"
        default 8192
        range 1 TIC_MAX_BUFFER_SIZE
        help
            Number of edge events to capture before swapping buffers.
            Lower values give more frequent statistics updates at high frequencies.

    config TIC_STATS_PERIOD_MS
        int "Stats period (ms)"
        default 1000
        range 100 60000
        help
            Maximum time between statistics reports, even if edge count
            threshold is not reached. Ensures periodic output with slow signals.

    config TIC_OUTPUT_CSV
        bool "CSV output format"
        default n
        help
            Output statistics in CSV format instead of table format.
            Useful for automated testing and data processing.

endmenu
```

## sdkconfig.defaults
```kconfig
# Target ESP32-S3
CONFIG_IDF_TARGET="esp32s3"

# CPU frequency 240 MHz
CONFIG_ESP_DEFAULT_CPU_FREQ_MHZ_240=y

# Enable FreeRTOS timer service
CONFIG_FREERTOS_USE_TRACE_FACILITY=y
```

## sdkconfig.defaults.wifi.example
```kconfig
CONFIG_TIC_WIFI_ENABLED=y
CONFIG_TIC_MQTT_PORT=1883
CONFIG_TIC_MQTT_TOPIC="tic"
CONFIG_TIC_WIFI_RING_SIZE=10

CONFIG_TIC_DEVICE_NAME="tic1"
CONFIG_TIC_WIFI_SSID=FIXME
CONFIG_TIC_WIFI_PASSWORD=FIXME
CONFIG_TIC_MQTT_BROKER="192.168.1.105"
```
